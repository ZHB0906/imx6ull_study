## emmc/br2-external/package/qscintilla/Config.in
```kconfig
config BR2_PACKAGE_QSCINTILLA
	bool "qscintilla"
	depends on BR2_PACKAGE_QT5
	select BR2_PACKAGE_QT5BASE
	select BR2_PACKAGE_QT5BASE_GUI
	select BR2_PACKAGE_QT5BASE_WIDGETS
	select BR2_PACKAGE_QT5BASE_PRINTSUPPORT
	help
	  QScintilla is a port of the Scintilla editing component to Qt.
	  SerialTool uses it as the base class of its text-transfer view
	  (syntax highlighting for C++/bash/lua/json).

	  https://www.riverbankcomputing.com/software/qscintilla/

comment "qscintilla needs Qt5"
	depends on !BR2_PACKAGE_QT5
```

## emmc/out/rebuild-snapshot/configs/atk_imx6ull_defconfig
```kconfig
BR2_arm=y
BR2_cortex_a7=y
BR2_ARM_FPU_NEON_VFPV4=y
BR2_JLEVEL=2
BR2_TOOLCHAIN_BUILDROOT_GLIBC=y
BR2_KERNEL_HEADERS_VERSION=y
BR2_DEFAULT_KERNEL_VERSION="4.1.15"
BR2_PACKAGE_HOST_LINUX_HEADERS_CUSTOM_4_1=y
BR2_TOOLCHAIN_BUILDROOT_CXX=y
BR2_TARGET_GENERIC_HOSTNAME="ATK-IMX6U-new"
BR2_TARGET_GENERIC_ISSUE="ATK-IMX6ULL new/ Buildroot rootfs (WiFi: Red)"
BR2_TARGET_GENERIC_ROOT_PASSWD="root"
BR2_TARGET_GENERIC_GETTY_PORT="ttymxc0"
BR2_TARGET_GENERIC_GETTY_BAUDRATE_115200=y
BR2_ROOTFS_OVERLAY="$(BR2_EXTERNAL_ATK_IMX6ULL_PATH)/board/atk/rootfs-overlay"
BR2_ROOTFS_POST_BUILD_SCRIPT="$(BR2_EXTERNAL_ATK_IMX6ULL_PATH)/board/atk/post-build.sh"
BR2_PACKAGE_BUSYBOX_CONFIG_FRAGMENT_FILES="$(BR2_EXTERNAL_ATK_IMX6ULL_PATH)/board/atk/busybox-telnetd.fragment"
BR2_PACKAGE_TSLIB=y
BR2_PACKAGE_DROPBEAR=y
BR2_PACKAGE_IW=y
BR2_PACKAGE_WIRELESS_TOOLS=y
BR2_PACKAGE_WPA_SUPPLICANT=y
BR2_PACKAGE_WPA_SUPPLICANT_CLI=y
BR2_PACKAGE_WPA_SUPPLICANT_PASSPHRASE=y
BR2_TARGET_ROOTFS_EXT2=y
BR2_TARGET_ROOTFS_EXT2_4=y
BR2_TARGET_ROOTFS_EXT2_SIZE="256M"
BR2_PACKAGE_HOST_DTC=y
```
